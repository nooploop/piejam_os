## br2_external/Config.in
```kconfig
source "$BR2_EXTERNAL_PIEJAM_PATH/package/benchmark/Config.in"
source "$BR2_EXTERNAL_PIEJAM_PATH/package/ladspa/Config.in"
source "$BR2_EXTERNAL_PIEJAM_PATH/package/ladspa_caps/Config.in"
source "$BR2_EXTERNAL_PIEJAM_PATH/package/ladspa_tap/Config.in"
source "$BR2_EXTERNAL_PIEJAM_PATH/package/piejam/Config.in"
```

## br2_external/configs/raspberrypi2_defconfig
```kconfig
BR2_arm=y
BR2_cortex_a7=y
BR2_ARM_FPU_NEON_VFPV4=y
BR2_JLEVEL=12
BR2_CCACHE=y
BR2_CCACHE_DIR="$(BASE_DIR)/.buildroot-ccache"
BR2_OPTIMIZE_3=y
BR2_SHARED_STATIC_LIBS=y
BR2_TOOLCHAIN_BUILDROOT_GLIBC=y
BR2_PACKAGE_HOST_LINUX_HEADERS_CUSTOM_4_19=y
BR2_GCC_VERSION_9_X=y
BR2_TOOLCHAIN_BUILDROOT_CXX=y
BR2_GCC_ENABLE_LTO=y
BR2_TOOLCHAIN_GLIBC_GCONV_LIBS_COPY=y
BR2_TARGET_GENERIC_HOSTNAME="piejam"
BR2_TARGET_GENERIC_ISSUE="Welcome to PieJam"
BR2_SYSTEM_BIN_SH_BASH=y
# BR2_TARGET_GENERIC_GETTY is not set
BR2_SYSTEM_DHCP="eth0"
BR2_ROOTFS_OVERLAY="$(BR2_EXTERNAL_PIEJAM_PATH)/board/raspberrypi2/rootfs-overlay"
BR2_ROOTFS_POST_IMAGE_SCRIPT="$(BR2_EXTERNAL_PIEJAM_PATH)/board/raspberrypi2/post-image.sh"
BR2_LINUX_KERNEL=y
BR2_LINUX_KERNEL_CUSTOM_TARBALL=y
BR2_LINUX_KERNEL_CUSTOM_TARBALL_LOCATION="$(call github,raspberrypi,linux,rpi-4.19.y)/linux-rpi-4.19.y.tar.gz"
BR2_LINUX_KERNEL_USE_CUSTOM_CONFIG=y
BR2_LINUX_KERNEL_CUSTOM_CONFIG_FILE="$(BR2_EXTERNAL_PIEJAM_PATH)/board/raspberrypi2/linux.config"
BR2_LINUX_KERNEL_CUSTOM_LOGO_PATH="$(BR2_EXTERNAL_PIEJAM_PATH)/boot_logo.png"
BR2_LINUX_KERNEL_DTS_SUPPORT=y
BR2_LINUX_KERNEL_INTREE_DTS_NAME="bcm2709-rpi-2-b"
BR2_LINUX_KERNEL_DTB_OVERLAY_SUPPORT=y
BR2_LINUX_KERNEL_NEEDS_HOST_OPENSSL=y
BR2_PACKAGE_BUSYBOX_CONFIG="$(BR2_EXTERNAL_PIEJAM_PATH)/board/raspberrypi2/busybox.config"
BR2_PACKAGE_BUSYBOX_SHOW_OTHERS=y
BR2_PACKAGE_RT_TESTS=y
BR2_PACKAGE_DEJAVU=y
BR2_PACKAGE_QT5BASE_FONTCONFIG=y
BR2_PACKAGE_RPI_FIRMWARE=y
BR2_PACKAGE_RNG_TOOLS=y
BR2_PACKAGE_RPI_USERLAND=y
BR2_PACKAGE_SPDLOG=y
# BR2_PACKAGE_IFUPDOWN_SCRIPTS is not set
BR2_PACKAGE_HTOP=y
BR2_TARGET_ROOTFS_EXT2=y
BR2_TARGET_ROOTFS_EXT2_4=y
BR2_TARGET_ROOTFS_EXT2_SIZE="150M"
BR2_PACKAGE_HOST_DOSFSTOOLS=y
BR2_PACKAGE_HOST_GENIMAGE=y
BR2_PACKAGE_HOST_MTOOLS=y
BR2_PACKAGE_PIEJAM=y
```

## br2_external/configs/raspberrypi4_defconfig
```kconfig
BR2_aarch64=y
BR2_cortex_a72=y
BR2_PACKAGE_HOST_LINUX_HEADERS_CUSTOM_6_12=y
BR2_PACKAGE_GLIBC_UTILS=y
BR2_TOOLCHAIN_BUILDROOT_CXX=y
BR2_TOOLCHAIN_GLIBC_GCONV_LIBS_COPY=y
BR2_CCACHE=y
BR2_CCACHE_DIR="$(BASE_DIR)/.buildroot-ccache"
BR2_OPTIMIZE_3=y
BR2_SHARED_STATIC_LIBS=y
BR2_GLOBAL_PATCH_DIR="$(BR2_EXTERNAL_PIEJAM_PATH)/patches"
BR2_TARGET_GENERIC_HOSTNAME="piejam"
BR2_TARGET_GENERIC_ISSUE="Welcome to PieJam"
BR2_SYSTEM_BIN_SH_BASH=y
BR2_SYSTEM_DHCP="eth0"
BR2_ROOTFS_OVERLAY="$(BR2_EXTERNAL_PIEJAM_PATH)/board/raspberrypi-common/rootfs $(BR2_EXTERNAL_PIEJAM_PATH)/board/raspberrypi4/rootfs"
BR2_ROOTFS_POST_IMAGE_SCRIPT="$(BR2_EXTERNAL_PIEJAM_PATH)/board/raspberrypi4/post-image.sh"
BR2_LINUX_KERNEL=y
BR2_LINUX_KERNEL_CUSTOM_TARBALL=y
BR2_LINUX_KERNEL_CUSTOM_TARBALL_LOCATION="$(call github,raspberrypi,linux,rpi-6.12.y)/linux-rpi-6.12.y.tar.gz"
BR2_LINUX_KERNEL_USE_CUSTOM_CONFIG=y
BR2_LINUX_KERNEL_CUSTOM_CONFIG_FILE="$(BR2_EXTERNAL_PIEJAM_PATH)/board/raspberrypi4/linux.config"
BR2_LINUX_KERNEL_LZ4=y
BR2_LINUX_KERNEL_DTS_SUPPORT=y
BR2_LINUX_KERNEL_INTREE_DTS_NAME="broadcom/bcm2711-rpi-4-b overlays/vc4-kms-v3d-overlay overlays/vc4-kms-v3d-pi4-overlay overlays/vc4-kms-dsi-7inch-overlay overlays/disable-bt-overlay overlays/overlay_map"
BR2_LINUX_KERNEL_DTB_OVERLAY_SUPPORT=y
BR2_PACKAGE_BUSYBOX_CONFIG="$(BR2_EXTERNAL_PIEJAM_PATH)/board/raspberrypi-common/busybox.config"
BR2_PACKAGE_BUSYBOX_SHOW_OTHERS=y
BR2_PACKAGE_E2FSPROGS=y
BR2_PACKAGE_MESA3D=y
BR2_PACKAGE_MESA3D_GALLIUM_DRIVER_V3D=y
BR2_PACKAGE_MESA3D_OPENGL_ES=y
BR2_PACKAGE_PSPLASH=y
BR2_PACKAGE_PSPLASH_IMAGE="$(BR2_EXTERNAL_PIEJAM_PATH)/boot_logo.png"
BR2_PACKAGE_RPI_FIRMWARE=y
BR2_PACKAGE_RPI_FIRMWARE_VARIANT_PI4=y
BR2_PACKAGE_RPI_FIRMWARE_CONFIG_FILE="$(BR2_EXTERNAL_PIEJAM_PATH)/board/raspberrypi4/rpi-firmware/config.txt"
BR2_PACKAGE_RPI_FIRMWARE_CMDLINE_FILE="$(BR2_EXTERNAL_PIEJAM_PATH)/board/raspberrypi4/rpi-firmware/cmdline.txt"
# BR2_PACKAGE_RPI_FIRMWARE_INSTALL_DTB_OVERLAYS is not set
BR2_PACKAGE_PARTED=y
BR2_PACKAGE_RNG_TOOLS=y
# BR2_PACKAGE_IFUPDOWN_SCRIPTS is not set
BR2_PACKAGE_HTOP=y
BR2_TARGET_ROOTFS_EXT2=y
BR2_TARGET_ROOTFS_EXT2_4=y
BR2_TARGET_ROOTFS_EXT2_SIZE="128M"
# BR2_TARGET_ROOTFS_TAR is not set
BR2_PACKAGE_HOST_DOSFSTOOLS=y
BR2_PACKAGE_HOST_GENIMAGE=y
BR2_PACKAGE_HOST_IMAGEMAGICK=y
BR2_PACKAGE_HOST_MTOOLS=y
```

## br2_external/package/benchmark/Config.in
```kconfig
config BR2_PACKAGE_BENCHMARK
	bool "benchmark"
	depends on BR2_INSTALL_LIBSTDCPP
	help
	  Google benchmark

comment "benchmark needs a toolchain w/ C++"
	depends on !BR2_INSTALL_LIBSTDCPP
```

## br2_external/package/ladspa_caps/Config.in
```kconfig
if BR2_PACKAGE_LADSPA

config BR2_PACKAGE_LADSPA_CAPS
	bool "CAPS LADSPA plugins"
	default y
	help
	  CAPS LADSPA plugins

endif
```

## br2_external/package/ladspa_tap/Config.in
```kconfig
if BR2_PACKAGE_LADSPA

config BR2_PACKAGE_LADSPA_TAP
	bool "TAP LADSPA plugins"
	help
	  TAP LADSPA plugins

endif
```

## br2_external/package/piejam/Config.in
```kconfig
config BR2_PACKAGE_PIEJAM
	bool "piejam"
	default y
	depends on BR2_INSTALL_LIBSTDCPP
	select BR2_PACKAGE_BOOST
	select BR2_PACKAGE_DEJAVU
	select BR2_PACKAGE_QT5
	select BR2_PACKAGE_QT5BASE_GUI
	select BR2_PACKAGE_QT5BASE_EGLFS
	select BR2_PACKAGE_QT5BASE_FONTCONFIG
	select BR2_PACKAGE_QT5BASE_PNG
	select BR2_PACKAGE_QT5GRAPHICALEFFECTS
	select BR2_PACKAGE_QT5QUICKCONTROLS2
	select BR2_PACKAGE_QT5VIRTUALKEYBOARD
	select BR2_PACKAGE_JSON_FOR_MODERN_CPP
	select BR2_PACKAGE_LADSPA
	select BR2_PACKAGE_SPDLOG
	select BR2_PACKAGE_FFTW
	select BR2_PACKAGE_FFTW_SINGLE
	select BR2_PACKAGE_LIBSNDFILE
	select BR2_PACKAGE_JQ
	select BR2_PACKAGE_PARTED
	select BR2_PACKAGE_RNG_TOOLS
	select BR2_PACKAGE_HTOP
	select BR2_PACKAGE_E2FSPROGS
	select BR2_PACKAGE_PSPLASH
	select BR2_PACKAGE_PSPLASH_FULL_SCREEN
	select BR2_PACKAGE_RPI_FIRMWARE
	select BR2_PACKAGE_HOST_DOSFSTOOLS
	select BR2_PACKAGE_HOST_GENIMAGE
	select BR2_PACKAGE_HOST_MTOOLS
	select BR2_PACKAGE_GLIBC_UTILS
	help
	  PieJam's main application

comment "piejam needs a toolchain w/ C++"
	depends on !BR2_INSTALL_LIBSTDCPP


if BR2_PACKAGE_PIEJAM

config BR2_PACKAGE_PIEJAM_BENCHMARKS
	bool "install PieJam benchmarks"
	default n
	select BR2_PACKAGE_BENCHMARK
	help
	  Build and install Piejam benchmarks

config BR2_PACKAGE_PIEJAM_TESTS
	bool "install PieJam tests"
	default n
	select BR2_PACKAGE_GTEST
	select BR2_PACKAGE_GTEST_GMOCK
	help
	  Build and install Piejam tests

endif
```
